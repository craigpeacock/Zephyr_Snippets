## CMakeLists.txt
```
# SPDX-License-Identifier: Apache-2.0

cmake_minimum_required(VERSION 3.20.0)

find_package(Zephyr REQUIRED HINTS $ENV{ZEPHYR_BASE})
project(cJSON)

FILE(GLOB app_sources src/*.c)
target_sources(app PRIVATE ${app_sources})
```

## prj.conf
```kconfig
CONFIG_CONSOLE=y
CONFIG_LOG=y
CONFIG_CJSON_LIB=y

# NEWLIB C
CONFIG_NEWLIB_LIBC=y
CONFIG_NEWLIB_LIBC_FLOAT_PRINTF=y
# Enable CPPRINTF (used in json_add_double)
CONFIG_CBPRINTF_LIBC_SUBSTS=y
CONFIG_CBPRINTF_FP_SUPPORT=y

# Heap and stacks
# Stack may need to be increased to prevent stack overflow using json_add_number()
CONFIG_MAIN_STACK_SIZE=2048
```

## src/main.c
```c
#include <stdio.h>
#include <string.h>
#include <stdlib.h>
#include <errno.h>
#include <zephyr/device.h>
#include <zephyr/kernel.h>
#include <zephyr/logging/log.h>
#include <cJSON.h>
#include <cJSON_os.h>
#include "json.h"

LOG_MODULE_REGISTER(cJSON);

int main(void)
{
	printk("Zephyr cJSON Example \nBoard: %s\n", CONFIG_BOARD);

	int err;
	char *message;

	cJSON *root_obj = cJSON_CreateObject();
	cJSON *payload_obj = cJSON_CreateObject();

	if (root_obj == NULL || payload_obj == NULL ) {
		cJSON_Delete(root_obj);
		cJSON_Delete(payload_obj);
		return (-ENOMEM);
	}

	err = 0;
	err += json_add_str(root_obj, "Parameter 1", "1.0");
	err += json_add_str(root_obj, "Parameter 2", "2.4");
	err += json_add_str(payload_obj, "Parameter 3", "Circle");
	err += json_add_number(payload_obj, "Value", 1.4);
	err += json_add_double(payload_obj, "Data", 1.4, 2);
	err += json_add_obj(root_obj, "payload", payload_obj);
	err += json_add_str(root_obj, "Parameter 4", "2.1");

	if (err) {
		LOG_ERR("cJSON Add Error %d", err);
	}

	message = cJSON_Print(root_obj);
	//message = cJSON_PrintUnformatted(root_obj);
	if (message == NULL) {
		LOG_ERR("cJSON_Print, error: returned NULL");
		cJSON_Delete(root_obj);
		return(-ENOMEM);
	}

	printk("%s\n", message);

	free(message);
	cJSON_Delete(root_obj);

	while(1) {
		k_sleep(K_SECONDS(10));
	}
}
```

## src/json.c
```c
#include <errno.h>
#include <cJSON.h>
#include "json.h"

int json_add_obj(cJSON *parent, const char *str, cJSON *item)
{
	cJSON_AddItemToObject(parent, str, item);

	return 0;
}

int json_add_str(cJSON *parent, const char *str, const char *item)
{
	cJSON *json_str;

	json_str = cJSON_CreateString(item);
	if (json_str == NULL) {
		return -ENOMEM;
	}

	return json_add_obj(parent, str, json_str);
}

int json_add_number(cJSON *parent, const char *str, double item)
{
	cJSON *json_num;

	json_num = cJSON_CreateNumber(item);
	if (json_num == NULL) {
		return -ENOMEM;
	}
	return json_add_obj(parent, str, json_num);
}

int json_add_double(cJSON *parent, const char *str, double item, int precision)
{
	cJSON *json_str;
	char tempStr[30];
	char *formatStr[7] = {"%.0f","%.1f","%.2f","%.3f","%.4f","%.5f","%.6f"};

	// Function uses snprintfcb - A built in Zephyr function. This requires the following CONFIG
	// CONFIG_CBPRINTF_LIBC_SUBSTS=y
	// CONFIG_CBPRINTF_FP_SUPPORT=y
	//printk("json_add_double, precision = %d, [%s], value = %f ",precision, formatStr[precision], item);
	snprintfcb(tempStr, sizeof(tempStr), formatStr[precision],item);
	//printk("Output %s\n", tempStr);

	json_str = cJSON_CreateString(tempStr);
	if (json_str == NULL) {
		return -ENOMEM;
	}
	return json_add_obj(parent, str, json_str);
}
```

## src/json.h
```c
int json_add_obj(cJSON *parent, const char *str, cJSON *item);
int json_add_str(cJSON *parent, const char *str, const char *item);
int json_add_number(cJSON *parent, const char *str, double item);
int json_add_double(cJSON *parent, const char *str, double item, int precision);
```
