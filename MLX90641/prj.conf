## CMakeLists.txt
```
# SPDX-License-Identifier: Apache-2.0

cmake_minimum_required(VERSION 3.20.0)

find_package(Zephyr REQUIRED HINTS $ENV{ZEPHYR_BASE})
project(MLX90641)

FILE(GLOB app_sources src/*.c)
target_sources(app PRIVATE ${app_sources})
```

## prj.conf
```kconfig
CONFIG_CONSOLE=y
CONFIG_LOG=y
CONFIG_I2C=y

# Increase main stack to prevent Stack Overflow
CONFIG_MAIN_STACK_SIZE=4096

# Enable CPPRINTF for float support
CONFIG_CBPRINTF_LIBC_SUBSTS=y
CONFIG_CBPRINTF_FP_SUPPORT=y

# Prevent console messages being dropped
CONFIG_LOG_BUFFER_SIZE=8192
```

## app.overlay
```dts
/ {
	outputs {
		compatible = "gpio-leds";
		output0: out0 {
			gpios = <&gpio0 2 GPIO_ACTIVE_LOW>;
			label = "Sensor Power Enable";
		};
	};

	aliases {
		pwr-en = &output0;
	};
};
```

## src/main.c
```c
/*
 * Example MLX90641 Code
 * Using Library from Melexis
 * https://github.com/melexis/mlx90641-library
 */

#include <stdio.h>
#include <string.h>
#include <zephyr/device.h>
#include <zephyr/kernel.h>
#include <zephyr/drivers/i2c.h>
#include <zephyr/logging/log.h>

#include "MLX90641_API.h"
#include "MLX90641_I2C_Driver.h"
#include "MLX90641_Helper.h"
#include "gpio.h"

LOG_MODULE_REGISTER(main);

// As the IR signal received by the sensor has two components:
// 	1. IR signal emitted by the object
// 	2. IR signal reflected from the object (the source of this signal is surrounding 
// environment of the sensor)
// In order to compensate correctly for the emissivity and achieve best accuracy we need to
// know the surrounding temperature which is responsible for the second component of the IR
// signal namely the reflected part - 𝑇𝑟. In case this 𝑇𝑟 temperature is not available and
// cannot be provided it might be replaced by 𝑇𝑟 ≈ 𝑇𝑎 − 5.
#define TA_SHIFT 5  // For a MLX90641 in the open air the shift is -5°C (Page 15, Rev 1.4 Driver Manual)
// Reflected Temperature:
// If the object emissivity is less than 1, there might be some temperature reflected from
// the object. In order for this to be compensated, the user should input this reflected
// temperature. The sensor ambient temperature could be used, but some shift depending on
// the enclosure might be needed. For a MLX90641 in the open air the shift is -5°C (TA_SHIFT)

int main(void)
{
	int ret;
	uint8_t addr = 0x33;
	static uint16_t mlx90641_eeData[832];
	static uint16_t mlx90641_frameData[242];
	paramsMLX90641 mlx90641_param;	// pointer to the MCU memory location where the
									// already extracted parameters for the MLX90641 device are stored

	static float mlx90641To[192];
	float tr = 0;
	float emissivity;

	float TempAmb;
	float TempObj;

	LOG_INF("Zephyr MLX90641 (16x12) Thermal Sensor Array Example");
	LOG_INF("Board: %s", CONFIG_BOARD);

	MLX90641_I2CInit();

	// Apply power to sensor
	gpio_init();

	MLX90641_DisplayResolution(addr);
	MLX90641_DisplayRefreshRate(addr);

	// Download and extract parameters from EEPROM:
	ret = MLX90641_DumpEE(addr, mlx90641_eeData);
	if (ret != 0) {
		LOG_ERR("Error %d dumping MLX90641 EEPROM", ret);
		return(-1);
	}

	MLX90641_DisplayDeviceID(mlx90641_eeData);
	MLX90641_DisplayEEPROM(mlx90641_eeData);

	ret = MLX90641_ExtractParameters(mlx90641_eeData, &mlx90641_param);
	if (ret != 0) {
		LOG_ERR("Error %d extracting parameters from MLX90641", ret);
		return(-1);
	}

	emissivity = MLX90641_GetEmissivity(&mlx90641_param);
	LOG_INF("Emissivity = %f", emissivity);

	LOG_INF("Temperature Gradient Coefficent = %f", mlx90641_param.tgc);

	// After POR the first valid data is available after 80mS + 2 * 500mS (refresh rate 2Hz) hence 1080mS
	k_sleep(K_MSEC(1080));

	do {
		// Get Frame Data. Function will block until a new subpage is avaliable - i.e 500mS for default 2Hz Refresh.
		ret = MLX90641_GetFrameData(addr, mlx90641_frameData);
		if (ret < 0) {
			LOG_ERR("Error %d getting frame data", ret);
		} else {
			LOG_INF("Updated sub-page %d:", ret);

			// Get Sensor Power Supply Voltage:
			LOG_INF("VDD = %.02fV", MLX90641_GetVdd(mlx90641_frameData, &mlx90641_param));

			// Get Ambient Temperature of Sensor:
			TempAmb = MLX90641_GetTa(mlx90641_frameData, &mlx90641_param);

			tr = TempAmb - TA_SHIFT; //reflected temperature based on the sensor ambient temperature

			// Calculate Array Temperature of Object:
			MLX90641_CalculateTo(mlx90641_frameData, &mlx90641_param, emissivity, tr, mlx90641To);

			// Display Temperatures
			for(int row = 0; row < 12; row++) {
				int i = row * 16;
				LOG_INF("TO%02d, %2.2f, %2.2f, %2.2f, %2.2f, %2.2f, %2.2f, %2.2f, %2.2f, %2.2f, %2.2f, %2.2f, %2.2f, %2.2f, %2.2f, %2.2f, %2.2f",
					row, 
					mlx90641To[i + 0], mlx90641To[i + 1], mlx90641To[i + 2], mlx90641To[i + 3],
					mlx90641To[i + 4], mlx90641To[i + 5], mlx90641To[i + 6], mlx90641To[i + 7],
					mlx90641To[i + 8], mlx90641To[i + 9], mlx90641To[i + 10], mlx90641To[i + 11],
					mlx90641To[i + 12], mlx90641To[i + 13], mlx90641To[i + 14], mlx90641To[i + 15]);
				};

			// Average the Array Values
			float average = 0;
			for (int i = 0; i < 192; i++) {
				average = average + mlx90641To[i];
			}
			TempObj =  average / 192;

			LOG_INF("Averaged Object Temp %.02lf degC, Ambient Temp %.02lf degC", TempObj, TempAmb);
		}

	} while (1);
}
```

## src/MLX90641_API.h
```c
/**
 * @copyright (C) 2017 Melexis N.V.
 *
 * Licensed under the Apache License, Version 2.0 (the "License");
 * you may not use this file except in compliance with the License.
 * You may obtain a copy of the License at
 *
 *     http://www.apache.org/licenses/LICENSE-2.0
 *
 * Unless required by applicable law or agreed to in writing, software
 * distributed under the License is distributed on an "AS IS" BASIS,
 * WITHOUT WARRANTIES OR CONDITIONS OF ANY KIND, either express or implied.
 * See the License for the specific language governing permissions and
 * limitations under the License.
 *
 */
#ifndef _MLX90641_API_H_
#define _MLX90641_API_H_

#define SCALEALPHA 0.000001

typedef struct
{
	int16_t kVdd;
	int16_t vdd25;
	float KvPTAT;
	float KtPTAT;
	uint16_t vPTAT25;
	float alphaPTAT;
	int16_t gainEE;
	float tgc;
	float cpKv;
	float cpKta;
	uint8_t resolutionEE;
	uint8_t calibrationModeEE;
	float KsTa;
	float ksTo[8];
	int16_t ct[8];
	uint16_t alpha[192];
	uint8_t alphaScale;
	int16_t offset[2][192];
	int8_t kta[192];
	uint8_t ktaScale;
	int8_t kv[192];
	uint8_t kvScale;
	float cpAlpha;
	int16_t cpOffset;
	float emissivityEE;
	uint16_t brokenPixel;
} paramsMLX90641;

int MLX90641_DumpEE(uint8_t slaveAddr, uint16_t *eeData);
int MLX90641_SynchFrame(uint8_t slaveAddr);
int MLX90641_TriggerMeasurement(uint8_t slaveAddr);
int MLX90641_GetFrameData(uint8_t slaveAddr, uint16_t *frameData);
int MLX90641_ExtractParameters(uint16_t *eeData, paramsMLX90641 *mlx90641);
float MLX90641_GetVdd(uint16_t *frameData, const paramsMLX90641 *params);
float MLX90641_GetTa(uint16_t *frameData, const paramsMLX90641 *params);
void MLX90641_GetImage(uint16_t *frameData, const paramsMLX90641 *params, float *result);
void MLX90641_CalculateTo(uint16_t *frameData, const paramsMLX90641 *params, float emissivity, float tr, float *result);
int MLX90641_SetResolution(uint8_t slaveAddr, uint8_t resolution);
int MLX90641_GetCurResolution(uint8_t slaveAddr);
int MLX90641_SetRefreshRate(uint8_t slaveAddr, uint8_t refreshRate);
int MLX90641_GetRefreshRate(uint8_t slaveAddr);
int MLX90641_GetSubPageNumber(uint16_t *frameData);
float MLX90641_GetEmissivity(const paramsMLX90641 *mlx90641);
void MLX90641_BadPixelsCorrection(uint16_t pixel, float *to);

#endif
```

## src/MLX90641_Helper.c
```c
#include <stdio.h>
#include <string.h>
#include <zephyr/device.h>
#include <zephyr/kernel.h>
#include <zephyr/logging/log.h>

#include "MLX90641_API.h"
#include "MLX90641_I2C_Driver.h"
#include "MLX90641_Helper.h"

LOG_MODULE_REGISTER(help);

void MLX90641_DisplayResolution(uint8_t addr)
{
	int ret = MLX90641_GetCurResolution(addr);
	switch(ret) {
		case 0x00:
			LOG_INF("Resoluton: 16-bit");
			break;

		case 0x01:
			LOG_INF("Resoluton: 17-bit");
			break;

		case 0x02:
			LOG_INF("Resoluton: 18-bit (default)");
			break;

		case 0x03:
			LOG_INF("Resoluton: 19-bit");
			break;

		default:
			LOG_ERR("Resolution: Unknown");
			break;
	}
}

void MLX90641_DisplayRefreshRate(uint8_t addr)
{
	int ret = MLX90641_GetRefreshRate(addr);
	switch(ret) {
		case 0x00:
			LOG_INF("Refresh Rate: 0.5Hz");
			break;

		case 0x01:
			LOG_INF("Refresh Rate: 1Hz");
			break;

		case 0x02:
			LOG_INF("Refresh Rate: 2Hz (default)");
			break;

		case 0x03:
			LOG_INF("Refresh Rate: 4Hz");
			break;

		case 0x04:
			LOG_INF("Refresh Rate: 8Hz");
			break;

		case 0x05:
			LOG_INF("Refresh Rate: 16Hz");
			break;

		case 0x06:
			LOG_INF("Refresh Rate: 32Hz");
			break;

		case 0x07:
			LOG_INF("Refresh Rate: 64Hz");
			break;

		default:
			LOG_ERR("Refresh Rate: Unknown");
			break;
	}
}

void MLX90641_DisplayDeviceID(uint16_t *eeData)
{
	LOG_INF("Device ID: 0x%04X:%04X:%04X", eeData[7], eeData[8], eeData[9]);
}

void MLX90641_DisplayEEPROM(uint16_t *eeData)
{
	// Dump EEPROM
	for (int i = 0; i <= 64; i++) {
		LOG_INF("0x%04X = 0x%04X", i + 0x2400, eeData[i]);
		k_sleep(K_MSEC(10)); // Give time for console to display (empty buffer)
	}
}
```

## src/MLX90641_Helper.h
```c
void MLX90641_DisplayResolution(uint8_t addr);
void MLX90641_DisplayRefreshRate(uint8_t addr);
void MLX90641_DisplayDeviceID(uint16_t *eeData);
void MLX90641_DisplayEEPROM(uint16_t *eeData);
```

## src/MLX90641_I2C_Driver.c
```c
/**
 * @copyright (C) 2017 Melexis N.V.
 *
 * Licensed under the Apache License, Version 2.0 (the "License");
 * you may not use this file except in compliance with the License.
 * You may obtain a copy of the License at
 *
 *     http://www.apache.org/licenses/LICENSE-2.0
 *
 * Unless required by applicable law or agreed to in writing, software
 * distributed under the License is distributed on an "AS IS" BASIS,
 * WITHOUT WARRANTIES OR CONDITIONS OF ANY KIND, either express or implied.
 * See the License for the specific language governing permissions and
 * limitations under the License.
 *
 */

#include <zephyr/device.h>
#include <zephyr/drivers/i2c.h>
#include <zephyr/logging/log.h>
#include "MLX90641_I2C_Driver.h"

LOG_MODULE_REGISTER(mlx90641);

const struct device *dev;

void MLX90641_I2CInit()
{
	dev = DEVICE_DT_GET(DT_ALIAS(i2cbus1));
	if (!dev) {
		LOG_ERR("I2C1: Device driver not found");
	} else {
		LOG_INF("I2C1 bus found, configuring speed");
		i2c_configure(dev, I2C_SPEED_SET(I2C_SPEED_STANDARD));
	}
}

int MLX90641_I2CGeneralReset(void)
{
	int ack;
	char cmd[2] = {0x00,0x06};

	ack = i2c_write(dev, &cmd[1], 1, 0x00);

	if (ack != 0x00)
	{
		return -1;
	}
	
	k_sleep(K_USEC(50));
	
	return 0;
}

int MLX90641_I2CRead(uint8_t slaveAddr, uint16_t startAddress, uint16_t nMemAddressRead, uint16_t *data)
{
	uint8_t sa;
	int ack = 0;
	int cnt = 0;
	int i = 0;
	char cmd[2] = {0,0};
	char i2cData[1664] = {0};
	uint16_t *p;
	
	p = data;
	sa = (slaveAddr << 1);
	cmd[0] = startAddress >> 8;
	cmd[1] = startAddress & 0x00FF;
	
	ack = i2c_write_read(dev, slaveAddr, cmd, 2, i2cData, 2*nMemAddressRead);
	if (ack != 0x00)
	{
		return -1;
	}

	for(cnt = 0; cnt < nMemAddressRead; cnt++)
	{
		i = cnt << 1;
		*p++ = (uint16_t)i2cData[i]*256 + (uint16_t)i2cData[i+1];
	}
	
	return 0;
} 

void MLX90641_I2CFreqSet(int freq)
{
	//i2c.frequency(1000*freq);
}

int MLX90641_I2CWrite(uint8_t slaveAddr, uint16_t writeAddress, uint16_t data)
{
	uint8_t sa;
	int ack = 0;
	char cmd[4] = {0,0,0,0};
	static uint16_t dataCheck;

	sa = (slaveAddr << 1);
	cmd[0] = writeAddress >> 8;
	cmd[1] = writeAddress & 0x00FF;
	cmd[2] = data >> 8;
	cmd[3] = data & 0x00FF;

	ack = i2c_write(dev, cmd, 4, slaveAddr);

	if (ack != 0x00)
	{
		return -1;
	}

	MLX90641_I2CRead(slaveAddr, writeAddress, 1, &dataCheck);
	
	if ( dataCheck != data)
	{
		return -2;
	}
	
	return 0;
}
```

## src/MLX90641_I2C_Driver.h
```c
/**
 * @copyright (C) 2017 Melexis N.V.
 *
 * Licensed under the Apache License, Version 2.0 (the "License");
 * you may not use this file except in compliance with the License.
 * You may obtain a copy of the License at
 *
 *     http://www.apache.org/licenses/LICENSE-2.0
 *
 * Unless required by applicable law or agreed to in writing, software
 * distributed under the License is distributed on an "AS IS" BASIS,
 * WITHOUT WARRANTIES OR CONDITIONS OF ANY KIND, either express or implied.
 * See the License for the specific language governing permissions and
 * limitations under the License.
 *
 */
#ifndef _MLX90641_I2C_Driver_H_
#define _MLX90641_I2C_Driver_H_

#include <stdint.h>

void MLX90641_I2CInit(void);
int MLX90641_I2CGeneralReset(void);
int MLX90641_I2CRead(uint8_t slaveAddr, uint16_t startAddress, uint16_t nMemAddressRead, uint16_t *data);
int MLX90641_I2CWrite(uint8_t slaveAddr, uint16_t writeAddress, uint16_t data);
void MLX90641_I2CFreqSet(int freq);

#endif
```

## src/gpio.c
```c
/*
 * Zephyr GPIO Example
 * Demonstrates basic general purpose input-output (GPIO) support.
 * Device Tree settings can be found in app.overlay file.
 * 
 * Zephyr GPIO API documentation can be found at 
 * https://docs.zephyrproject.org/latest/hardware/peripherals/gpio.html
 * 
 * SPDX-License-Identifier: Apache-2.0
 */

 #include <stdio.h>
 #include <string.h>
 #include <zephyr/device.h>
 #include <zephyr/kernel.h>
 #include <zephyr/drivers/gpio.h>

static const struct gpio_dt_spec gpio_pwr_enable = GPIO_DT_SPEC_GET(DT_ALIAS(pwr_en), gpios);

void gpio_init(void)
{
	int ret;

	ret = gpio_pin_configure_dt(&gpio_pwr_enable, GPIO_OUTPUT_ACTIVE);
	if (ret < 0) {
		return;
	}

	gpio_pin_set_dt(&gpio_pwr_enable, 1);
}
```

## src/gpio.h
```c
void gpio_init(void);
```
